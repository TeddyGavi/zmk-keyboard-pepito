## boards/shields/clickety_split_pepito/Kconfig.defconfig
```kconfig
# Copyright (c) 2024 The ZMK Contributors
# SPDX-License-Identifier: MIT

if SHIELD_CLICKETY_SPLIT_PEPITO_LEFT

config ZMK_KEYBOARD_NAME
    default "Pepito v1.13"

endif
```
